## configs/cortexm3_defconfig
```kconfig
BR2_arm=y
BR2_cortex_m3=y
BR2_KERNEL_HEADERS_4_4=y
BR2_PTHREADS_NONE=y
BR2_GCC_VERSION_7_X=y
BR2_TARGET_RUN_TESTSCRIPT=y
BR2_PACKAGE_BUSYBOX_CONFIG="package/busybox/busybox-m3.config"
BR2_TARGET_ROOTFS_CPIO=y
BR2_TARGET_ROOTFS_CPIO_GZIP=y
BR2_TARGET_ROOTFS_EXT2=y
BR2_TARGET_ROOTFS_EXT2_SIZE="10M"
BR2_TARGET_AFBOOT_STM32=y
```

## configs/kerneltests_armv7a_defconfig
```kconfig
BR2_arm=y
BR2_cortex_a5=y
BR2_TOOLCHAIN_BUILDROOT_MUSL=y
BR2_KERNEL_HEADERS_4_14=y
BR2_BINUTILS_VERSION_2_39_X=y
BR2_TARGET_RUN_TESTSCRIPT=y
BR2_SYSTEM_DHCP="eth0"
BR2_PACKAGE_BUSYBOX_SHOW_OTHERS=y
BR2_PACKAGE_STRACE=y
BR2_PACKAGE_I2C_TOOLS=y
BR2_PACKAGE_PCIUTILS=y
BR2_PACKAGE_DTC=y
BR2_PACKAGE_DTC_PROGRAMS=y
BR2_PACKAGE_IPROUTE2=y
BR2_TARGET_ROOTFS_BTRFS=y
BR2_TARGET_ROOTFS_CPIO=y
BR2_TARGET_ROOTFS_CPIO_GZIP=y
BR2_TARGET_ROOTFS_EROFS=y
BR2_TARGET_ROOTFS_EROFS_LZ4HC=y
BR2_TARGET_ROOTFS_EXT2=y
BR2_TARGET_ROOTFS_EXT2_SIZE="16M"
BR2_TARGET_ROOTFS_EXT2_GZIP=y
BR2_TARGET_ROOTFS_F2FS=y
BR2_TARGET_ROOTFS_F2FS_GZIP=y
BR2_TARGET_ROOTFS_ISO_GZIP=y
BR2_TARGET_ROOTFS_SQUASHFS=y
# BR2_TARGET_ROOTFS_TAR is not set
```

## configs/kerneltests_m68k_5208_defconfig
```kconfig
BR2_m68k=y
BR2_m68k_cf5208=y
BR2_TARGET_RUN_TESTSCRIPT=y
BR2_TARGET_GENERIC_GETTY_PORT="ttyS0"
BR2_SYSTEM_DHCP="eth0"
BR2_TARGET_ROOTFS_CPIO=y
BR2_TARGET_ROOTFS_CPIO_GZIP=y
BR2_TARGET_ROOTFS_EXT2=y
BR2_TARGET_ROOTFS_EXT2_SIZE="16M"
BR2_TARGET_ROOTFS_EXT2_GZIP=y
BR2_TARGET_ROOTFS_ISO_GZIP=y
# BR2_TARGET_ROOTFS_TAR is not set
BR2_PACKAGE_HOST_KMOD=y
```

## configs/kerneltests_m68k_q800_defconfig
```kconfig
BR2_m68k=y
BR2_KERNEL_HEADERS_4_9=y
BR2_BINUTILS_VERSION_2_33_X=y
BR2_GCC_VERSION_9_X=y
BR2_TARGET_RUN_TESTSCRIPT=y
BR2_SYSTEM_DHCP="eth0"
BR2_PACKAGE_PCIUTILS=y
BR2_TARGET_ROOTFS_CPIO=y
BR2_TARGET_ROOTFS_CPIO_GZIP=y
BR2_TARGET_ROOTFS_EXT2=y
BR2_TARGET_ROOTFS_EXT2_SIZE="16M"
BR2_TARGET_ROOTFS_EXT2_GZIP=y
BR2_TARGET_ROOTFS_ISO_GZIP=y
# BR2_TARGET_ROOTFS_TAR is not set
```

## configs/kerneltests_openrisc_defconfig
```kconfig
BR2_or1k=y
BR2_TOOLCHAIN_BUILDROOT_MUSL=y
BR2_KERNEL_HEADERS_4_4=y
BR2_BINUTILS_VERSION_2_36_X=y
BR2_TARGET_RUN_TESTSCRIPT=y
BR2_SYSTEM_DHCP="eth0"
BR2_PACKAGE_PCIUTILS=y
BR2_TARGET_ROOTFS_BTRFS=y
BR2_TARGET_ROOTFS_CPIO=y
BR2_TARGET_ROOTFS_CPIO_GZIP=y
BR2_TARGET_ROOTFS_EXT2=y
BR2_TARGET_ROOTFS_EXT2_SIZE="16M"
BR2_TARGET_ROOTFS_EXT2_GZIP=y
BR2_TARGET_ROOTFS_ISO_GZIP=y
BR2_TARGET_ROOTFS_SQUASHFS=y
# BR2_TARGET_ROOTFS_TAR is not set
```

## configs/kerneltests_ppc64_defconfig
```kconfig
BR2_powerpc64=y
BR2_KERNEL_HEADERS_4_4=y
BR2_BINUTILS_VERSION_2_33_X=y
BR2_GCC_VERSION_9_X=y
BR2_TARGET_RUN_TESTSCRIPT=y
BR2_SYSTEM_DHCP="eth0"
BR2_PACKAGE_BUSYBOX_SHOW_OTHERS=y
BR2_PACKAGE_I2C_TOOLS=y
BR2_PACKAGE_PCIUTILS=y
BR2_PACKAGE_DTC=y
BR2_PACKAGE_DTC_PROGRAMS=y
BR2_TARGET_ROOTFS_CPIO=y
BR2_TARGET_ROOTFS_CPIO_GZIP=y
BR2_TARGET_ROOTFS_EXT2=y
BR2_TARGET_ROOTFS_EXT2_SIZE="16M"
BR2_TARGET_ROOTFS_EXT2_GZIP=y
BR2_TARGET_ROOTFS_ISO_GZIP=y
BR2_TARGET_ROOTFS_SQUASHFS=y
# BR2_TARGET_ROOTFS_TAR is not set
```

## configs/kerneltests_ppc64le_defconfig
```kconfig
BR2_powerpc64le=y
BR2_KERNEL_HEADERS_4_4=y
BR2_BINUTILS_VERSION_2_36_X=y
BR2_TARGET_RUN_TESTSCRIPT=y
BR2_TARGET_GENERIC_GETTY_PORT="hvc0"
BR2_SYSTEM_DHCP="eth0"
BR2_PACKAGE_BUSYBOX_SHOW_OTHERS=y
BR2_PACKAGE_I2C_TOOLS=y
BR2_PACKAGE_PCIUTILS=y
BR2_PACKAGE_DTC=y
BR2_PACKAGE_DTC_PROGRAMS=y
BR2_TARGET_ROOTFS_CPIO=y
BR2_TARGET_ROOTFS_CPIO_GZIP=y
BR2_TARGET_ROOTFS_EXT2=y
BR2_TARGET_ROOTFS_EXT2_SIZE="16M"
BR2_TARGET_ROOTFS_EXT2_GZIP=y
BR2_TARGET_ROOTFS_ISO_GZIP=y
BR2_TARGET_ROOTFS_SQUASHFS=y
# BR2_TARGET_ROOTFS_TAR is not set
```

## configs/kerneltests_sh_defconfig
```kconfig
BR2_sh=y
BR2_TOOLCHAIN_BUILDROOT_MUSL=y
BR2_KERNEL_HEADERS_4_4=y
BR2_BINUTILS_VERSION_2_36_X=y
BR2_TARGET_RUN_TESTSCRIPT=y
BR2_SHUTDOWN_COMMAND_POWEROFF=y
BR2_SYSTEM_DHCP="eth0"
BR2_TARGET_ROOTFS_CPIO=y
BR2_TARGET_ROOTFS_CPIO_GZIP=y
BR2_TARGET_ROOTFS_EXT2=y
BR2_TARGET_ROOTFS_EXT2_SIZE="16M"
BR2_TARGET_ROOTFS_EXT2_GZIP=y
BR2_TARGET_ROOTFS_ISO_GZIP=y
BR2_TARGET_ROOTFS_SQUASHFS=y
# BR2_TARGET_ROOTFS_TAR is not set
```

## configs/kerneltests_xtensa_dc232b_defconfig
```kconfig
BR2_xtensa=y
BR2_XTENSA_CUSTOM=y
BR2_XTENSA_OVERLAY_FILE="https://github.com/jcmvbkbc/xtensa-toolchain-build/raw/master/overlays/xtensa_dc232b.tar.gz"
BR2_KERNEL_HEADERS_4_14=y
BR2_BINUTILS_VERSION_2_36_X=y
BR2_GCC_VERSION_10_X=y
BR2_TARGET_RUN_TESTSCRIPT=y
BR2_TARGET_GENERIC_GETTY_PORT="ttyS0"
BR2_SYSTEM_DHCP="eth0"
BR2_PACKAGE_STRACE=y
BR2_PACKAGE_PCIUTILS=y
BR2_PACKAGE_IPROUTE2=y
BR2_TARGET_ROOTFS_CPIO=y
BR2_TARGET_ROOTFS_CPIO_GZIP=y
BR2_TARGET_ROOTFS_EXT2=y
BR2_TARGET_ROOTFS_EXT2_SIZE="16M"
BR2_TARGET_ROOTFS_EXT2_GZIP=y
# BR2_TARGET_ROOTFS_ISO is not set
BR2_TARGET_ROOTFS_SQUASHFS=y
# BR2_TARGET_ROOTFS_TAR is not set
BR2_PACKAGE_HOST_KMOD=y
BR2_PACKAGE_HOST_UBOOT_TOOLS=y
```

## configs/kerneltests_xtensa_de212_defconfig
```kconfig
BR2_xtensa=y
BR2_XTENSA_CUSTOM=y
BR2_XTENSA_OVERLAY_FILE="https://github.com/jcmvbkbc/xtensa-toolchain-build/raw/95291b7c39e6f790d0b2f062c945a630290f2c81/overlays/xtensa_de212.tar.gz"
BR2_KERNEL_HEADERS_4_14=y
BR2_GCC_VERSION_10_X=y
# BR2_TARGET_ENABLE_ROOT_LOGIN is not set
BR2_TARGET_RUN_TESTSCRIPT=y
BR2_TARGET_GENERIC_GETTY_PORT="ttyS0"
BR2_SYSTEM_DHCP="eth0"
BR2_PACKAGE_PCIUTILS=y
BR2_TARGET_ROOTFS_CPIO=y
BR2_TARGET_ROOTFS_CPIO_GZIP=y
# BR2_TARGET_ROOTFS_ISO is not set
# BR2_TARGET_ROOTFS_TAR is not set
```

## configs/mips_32r6_defconfig
```kconfig
BR2_mipsel=y
BR2_mips_32r6=y
# BR2_MIPS_SOFT_FLOAT is not set
BR2_KERNEL_HEADERS_3_2=y
BR2_BINUTILS_VERSION_2_30_X=y
BR2_TARGET_RUN_TESTSCRIPT=y
BR2_TARGET_ROOTFS_CPIO=y
BR2_TARGET_ROOTFS_EXT2=y
BR2_TARGET_ROOTFS_EXT2_SIZE="10M"
BR2_TARGET_ROOTFS_SQUASHFS=y
# BR2_TARGET_ROOTFS_TAR is not set
```

## configs/mipsel64r1_defconfig
```kconfig
BR2_mips64el=y
BR2_MIPS_NABI64=y
# BR2_MIPS_SOFT_FLOAT is not set
BR2_TOOLCHAIN_BUILDROOT_GLIBC=y
BR2_KERNEL_HEADERS_3_2=y
BR2_BINUTILS_VERSION_2_30_X=y
BR2_TARGET_RUN_TESTSCRIPT=y
BR2_TARGET_ROOTFS_CPIO=y
BR2_TARGET_ROOTFS_EXT2=y
BR2_TARGET_ROOTFS_EXT2_SIZE="10M"
BR2_TARGET_ROOTFS_SQUASHFS=y
# BR2_TARGET_ROOTFS_TAR is not set
```

## configs/parisc_defconfig
```kconfig
BR2_parisc=y
BR2_KERNEL_HEADERS_4_14=y
BR2_BINUTILS_VERSION_2_30_X=y
BR2_GCC_VERSION_7_X=y
BR2_TARGET_RUN_TESTSCRIPT=y
BR2_TARGET_GENERIC_GETTY_PORT="ttyS0"
BR2_TARGET_GENERIC_GETTY_BAUDRATE_115200=y
BR2_TARGET_ROOTFS_CPIO=y
BR2_TARGET_ROOTFS_EXT2=y
BR2_TARGET_ROOTFS_SQUASHFS=y
# BR2_TARGET_ROOTFS_TAR is not set
```

## configs/ppc64le_defconfig
```kconfig
BR2_powerpc64le=y
BR2_KERNEL_HEADERS_3_2=y
BR2_BINUTILS_VERSION_2_30_X=y
BR2_GCC_VERSION_7_X=y
BR2_TARGET_RUN_TESTSCRIPT=y
BR2_TARGET_GENERIC_GETTY_PORT="hvc0"
BR2_SYSTEM_DHCP="eth0"
BR2_TARGET_ROOTFS_CPIO=y
BR2_TARGET_ROOTFS_EXT2=y
BR2_TARGET_ROOTFS_EXT2_SIZE="10M"
BR2_TARGET_ROOTFS_SQUASHFS=y
# BR2_TARGET_ROOTFS_TAR is not set
```

## configs/qemu_m68k_q800_defconfig
```kconfig
BR2_m68k=y
BR2_PACKAGE_HOST_LINUX_HEADERS_CUSTOM_4_11=y
BR2_TARGET_RUN_TESTSCRIPT=y
BR2_TARGET_GENERIC_GETTY_PORT="ttyS0"
BR2_SYSTEM_DHCP="eth0"

# Filesystem
BR2_TARGET_ROOTFS_EXT2=y
# BR2_TARGET_ROOTFS_TAR is not set

# Image
BR2_ROOTFS_POST_IMAGE_SCRIPT="board/qemu/post-image.sh"
BR2_ROOTFS_POST_SCRIPT_ARGS="$(BR2_DEFCONFIG)"

# Linux headers same as kernel, a 5.4 series
BR2_PACKAGE_HOST_LINUX_HEADERS_CUSTOM_5_4=y

# Kernel
BR2_LINUX_KERNEL=y
BR2_LINUX_KERNEL_CUSTOM_VERSION=y
BR2_LINUX_KERNEL_CUSTOM_VERSION_VALUE="5.4.35"
BR2_LINUX_KERNEL_USE_CUSTOM_CONFIG=y
BR2_LINUX_KERNEL_CUSTOM_CONFIG_FILE="board/qemu/m68k-q800/linux-4.11.config"
BR2_TARGET_ROOTFS_CPIO=y
BR2_TARGET_ROOTFS_CPIO_LZ4=y
BR2_TARGET_ROOTFS_EXT2=y
BR2_TARGET_ROOTFS_EXT2_SIZE="10M"
# BR2_TARGET_ROOTFS_TAR is not set
```

## configs/qemu_xtensa_kc705_nommu_defconfig
```kconfig
BR2_xtensa=y
BR2_XTENSA_CUSTOM=y
BR2_XTENSA_OVERLAY_FILE="https://github.com/jcmvbkbc/xtensa-toolchain-build/raw/95291b7c39e6f790d0b2f062c945a630290f2c81/overlays/xtensa_de212.tar.gz"
BR2_KERNEL_HEADERS_4_4=y
BR2_PTHREADS_NONE=y
BR2_PACKAGE_HOST_ELF2FLT=y
# BR2_USE_MMU is not set
# BR2_TARGET_ENABLE_ROOT_LOGIN is not set
BR2_TARGET_RUN_TESTSCRIPT=y
BR2_TARGET_GENERIC_GETTY_PORT="ttyS0"
BR2_TARGET_ROOTFS_CPIO=y
# BR2_TARGET_ROOTFS_TAR is not set
```

## configs/qemu_xtensa_lx60_dc232b_defconfig
```kconfig
BR2_xtensa=y
BR2_XTENSA_CUSTOM=y
BR2_XTENSA_OVERLAY_FILE="https://github.com/jcmvbkbc/xtensa-toolchain-build/raw/master/overlays/xtensa_dc232b.tar.gz"
BR2_PACKAGE_HOST_LINUX_HEADERS_CUSTOM_4_4=y
BR2_BINUTILS_VERSION_2_32_X=y
BR2_GCC_VERSION_8_X=y
BR2_TARGET_RUN_TESTSCRIPT=y
BR2_TARGET_GENERIC_GETTY_PORT="ttyS0"
BR2_SYSTEM_DHCP="eth0"
BR2_LINUX_KERNEL=y
BR2_LINUX_KERNEL_CUSTOM_VERSION=y
BR2_LINUX_KERNEL_CUSTOM_VERSION_VALUE="4.4.206"
BR2_LINUX_KERNEL_USE_CUSTOM_CONFIG=y
BR2_LINUX_KERNEL_CUSTOM_CONFIG_FILE="board/qemu/xtensa-lx60/linux-dc232b.config"
BR2_LINUX_KERNEL_IMAGE_TARGET_CUSTOM=y
BR2_LINUX_KERNEL_IMAGE_TARGET_NAME="arch/xtensa/boot/uImage"
BR2_LINUX_KERNEL_IMAGE_NAME="Image.elf"
BR2_TARGET_ROOTFS_CPIO=y
BR2_TARGET_ROOTFS_CPIO_GZIP=y
BR2_TARGET_ROOTFS_EXT2=y
BR2_TARGET_ROOTFS_EXT2_SIZE="15M"
BR2_TARGET_ROOTFS_EXT2_GZIP=y
# BR2_TARGET_ROOTFS_ISO is not set
BR2_TARGET_ROOTFS_SQUASHFS=y
# BR2_TARGET_ROOTFS_TAR is not set
BR2_PACKAGE_HOST_UBOOT_TOOLS=y
```

## configs/qemu_xtensa_lx60_defconfig
```kconfig
BR2_xtensa=y
BR2_XTENSA_CUSTOM=y
BR2_XTENSA_OVERLAY_FILE="https://github.com/jcmvbkbc/xtensa-toolchain-build/raw/95291b7c39e6f790d0b2f062c945a630290f2c81/overlays/xtensa_dc233c.tar.gz"
BR2_PACKAGE_HOST_LINUX_HEADERS_CUSTOM_4_4=y
BR2_BINUTILS_VERSION_2_32_X=y
BR2_GCC_VERSION_8_X=y
BR2_TARGET_RUN_TESTSCRIPT=y
BR2_TARGET_GENERIC_GETTY_PORT="ttyS0"

# Filesystem
# BR2_TARGET_ROOTFS_TAR is not set
BR2_TARGET_ROOTFS_INITRAMFS=y

# Image
BR2_ROOTFS_POST_IMAGE_SCRIPT="board/qemu/post-image.sh"
BR2_ROOTFS_POST_SCRIPT_ARGS="$(BR2_DEFCONFIG)"

# Linux headers same as kernel, a 5.4 series
BR2_PACKAGE_HOST_LINUX_HEADERS_CUSTOM_5_4=y

# Kernel
BR2_SYSTEM_DHCP="eth0"
BR2_LINUX_KERNEL=y
BR2_LINUX_KERNEL_CUSTOM_VERSION=y
BR2_LINUX_KERNEL_CUSTOM_VERSION_VALUE="5.4.35"
BR2_LINUX_KERNEL_USE_CUSTOM_CONFIG=y
BR2_LINUX_KERNEL_CUSTOM_CONFIG_FILE="board/qemu/xtensa-lx60/linux.config"
BR2_LINUX_KERNEL_IMAGE_TARGET_CUSTOM=y
BR2_LINUX_KERNEL_IMAGE_TARGET_NAME="arch/xtensa/boot/uImage"
BR2_LINUX_KERNEL_IMAGE_NAME="Image.elf"
BR2_TARGET_ROOTFS_CPIO=y
BR2_TARGET_ROOTFS_CPIO_GZIP=y
BR2_TARGET_ROOTFS_EXT2=y
BR2_TARGET_ROOTFS_EXT2_SIZE="16M"
BR2_TARGET_ROOTFS_EXT2_GZIP=y
# BR2_TARGET_ROOTFS_ISO is not set
BR2_TARGET_ROOTFS_SQUASHFS=y
# BR2_TARGET_ROOTFS_TAR is not set
BR2_PACKAGE_HOST_UBOOT_TOOLS=y

# host-qemu for gitlab testing
BR2_PACKAGE_HOST_QEMU=y
BR2_PACKAGE_HOST_QEMU_SYSTEM_MODE=y
```

## configs/riscv64_defconfig
```kconfig
BR2_riscv64=y
BR2_BINUTILS_VERSION_2_29_X=y
BR2_GCC_VERSION_7_X=y
BR2_LINUX_KERNEL=y
BR2_LINUX_KERNEL_CUSTOM_GIT=y
BR2_LINUX_KERNEL_CUSTOM_REPO_URL="git://git.kernel.org/pub/scm/linux/kernel/git/torvalds/linux.git"
BR2_LINUX_KERNEL_CUSTOM_REPO_VERSION="master"
BR2_LINUX_KERNEL_DEFCONFIG="defconfig"
```

## configs/sh4eb_defconfig
```kconfig
BR2_sh=y
BR2_sh4eb=y
BR2_TOOLCHAIN_BUILDROOT_GLIBC=y
BR2_KERNEL_HEADERS_3_2=y
BR2_BINUTILS_VERSION_2_30_X=y
BR2_GCC_VERSION_7_X=y
BR2_TARGET_RUN_TESTSCRIPT=y
BR2_TARGET_ROOTFS_CPIO=y
BR2_TARGET_ROOTFS_EXT2=y
BR2_TARGET_ROOTFS_EXT2_SIZE="10M"
BR2_TARGET_ROOTFS_SQUASHFS=y
# BR2_TARGET_ROOTFS_TAR is not set
```

## fs/exfat/Config.in
```kconfig
config BR2_TARGET_ROOTFS_EXFAT
	bool "exfat root filesystem"
	select BR2_PACKAGE_HOST_EXFAT_TOOLS
	help
	  Build a exfat root filesystem. If you enable this option, you
	  probably want to enable the exfat-tools package too.

if BR2_TARGET_ROOTFS_EXFAT

config BR2_TARGET_ROOTFS_EXFAT_LABEL
	string "filesystem label"

config BR2_TARGET_ROOTFS_EXFAT_SIZE
	string "filesystem size"
	default "16M"
	help
	  The size of the filesystem image in bytes.
	  Suffix with K, M, G or T for power-of-two kilo-, mega-, giga-
	  or terabytes.

choice
	prompt "Compression method"
	default BR2_TARGET_ROOTFS_EXFAT_NONE
	help
	  Select compressor for exfat filesystem of the root
	  filesystem

config BR2_TARGET_ROOTFS_EXFAT_NONE
	bool "no compression"
	help
	  Do not compress the exfat filesystem.

config BR2_TARGET_ROOTFS_EXFAT_GZIP
	bool "gzip"
	help
	  Do compress the exfat filesystem with gzip.

config BR2_TARGET_ROOTFS_EXFAT_BZIP2
	bool "bzip2"
	help
	  Do compress the exfat filesystem with bzip2.

config BR2_TARGET_ROOTFS_EXFAT_LZ4
	bool "lz4"
	help
	  Do compress the exfat filesystem with lz4.

config BR2_TARGET_ROOTFS_EXFAT_LZMA
	bool "lzma"
	help
	  Do compress the exfat filesystem with lzma.

config BR2_TARGET_ROOTFS_EXFAT_LZO
	bool "lzo"
	help
	  Do compress the exfat filesystem with lzop.

config BR2_TARGET_ROOTFS_EXFAT_XZ
	bool "xz"
	help
	  Do compress the exfat filesystem with xz.

config BR2_TARGET_ROOTFS_EXFAT_ZSTD
	bool "zstd"
	help
	  Do compress the exfat filesystem with zstd.

endchoice
endif # BR2_TARGET_ROOTFS_EXFAT
```

## fs/f2fs/Config.in
```kconfig
config BR2_TARGET_ROOTFS_F2FS
	bool "f2fs root filesystem"
	select BR2_PACKAGE_HOST_F2FS_TOOLS
	help
	  Build a f2fs root filesystem. If you enable this option, you
	  probably want to enable the f2fs-tools package too.

if BR2_TARGET_ROOTFS_F2FS

config BR2_TARGET_ROOTFS_F2FS_LABEL
	string "filesystem label"

config BR2_TARGET_ROOTFS_F2FS_SIZE
	string "filesystem size"
	default "100M"
	help
	  The size of the filesystem image in bytes.
	  Suffix with K, M, G or T for power-of-two kilo-, mega-, giga-
	  or terabytes.

config BR2_TARGET_ROOTFS_F2FS_COLD_FILES
	string "extension list for cold files"
	help
	  Specify a comma separated file extension list in order f2fs
	  to treat them as cold files. The default list includes most
	  of multimedia file extensions such as jpg, gif, mpeg, mkv,
	  and so on.

config BR2_TARGET_ROOTFS_F2FS_HOT_FILES
	string "extension list for hot files"
	help
	  Specify a comma separated file extension list in order f2fs
	  to treat them as hot files. The default list includes only
	  a db extension.

config BR2_TARGET_ROOTFS_F2FS_OVERPROVISION
	int "overprovision ratio"
	default 0
	help
	  The percentage over the volume size for overprovision
	  area. This area is hidden to users, and utilized by F2FS
	  cleaner.

	  Leave at 0 for autocalculation according to the partition
	  size.

config BR2_TARGET_ROOTFS_F2FS_DISCARD
	bool "discard policy"
	default y
	help
	  Enable or disable discard policy.

config BR2_TARGET_ROOTFS_F2FS_FEATURES
	string "filesystem features"
	help
	  List of features that the F2FS filesystem should support
	  (e.g "encrypt")

choice
	prompt "Compression method"
	default BR2_TARGET_ROOTFS_F2FS_NONE
	help
	  Select compressor for ext2/3/4 filesystem of the root
	  filesystem

config BR2_TARGET_ROOTFS_F2FS_NONE
	bool "no compression"
	help
	  Do not compress the ext2/3/4 filesystem.

config BR2_TARGET_ROOTFS_F2FS_GZIP
	bool "gzip"
	help
	  Do compress the ext2/3/4 filesystem with gzip.

config BR2_TARGET_ROOTFS_F2FS_BZIP2
	bool "bzip2"
	help
	  Do compress the ext2/3/4 filesystem with bzip2.

config BR2_TARGET_ROOTFS_F2FS_LZ4
	bool "lz4"
	help
	  Do compress the ext2 filesystem with lz4.

config BR2_TARGET_ROOTFS_F2FS_LZMA
	bool "lzma"
	help
	  Do compress the ext2/3/4 filesystem with lzma.

config BR2_TARGET_ROOTFS_F2FS_LZO
	bool "lzo"
	help
	  Do compress the ext2 filesystem with lzop.

config BR2_TARGET_ROOTFS_F2FS_XZ
	bool "xz"
	help
	  Do compress the ext2 filesystem with xz.

config BR2_TARGET_ROOTFS_F2FS_ZSTD
	bool "zstd"
	help
	  Do compress the ext2 filesystem with zstd.

endchoice
endif # BR2_TARGET_ROOTFS_F2FS
```
